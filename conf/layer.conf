## conf/layer.conf
```bitbake
BBPATH .= ":${LAYERDIR}"
BBFILES += " \
    ${LAYERDIR}/recipes-*/*/*.bb \
    ${LAYERDIR}/recipes-*/*/*.bbappend \
"

# Holoscan SDK and the HoloMQ patches for iceoryx2 need meta-iceoryx2.
BBFILES_DYNAMIC += " \
    meta-iceoryx2:${LAYERDIR}/dynamic-layers/meta-iceoryx2/recipes-*/*/*.bb \
    meta-iceoryx2:${LAYERDIR}/dynamic-layers/meta-iceoryx2/recipes-*/*/*.bbappend \
"

BBFILE_COLLECTIONS += "tegra-community"
BBFILE_PATTERN_tegra-community = "^${LAYERDIR}/"
BBFILE_PRIORITY_tegra-community = "20"

LAYERVERSION_tegra-community = "1"
LAYERDEPENDS_tegra-community = "core tegra openembedded-layer meta-python"
LAYERSERIES_COMPAT_tegra-community = "blacksail"

LICENSE_PATH += "${LAYERDIR}/licenses"
```
